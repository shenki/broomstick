## openbmc/Config.in
```kconfig
config BR2_OPENBMC_PLATFORM
	bool "OpenBMC Platform"
        default n
	depends on BR2_arm

if BR2_OPENBMC_PLATFORM
comment "OpenBMC Packages"
source "$BR2_EXTERNAL_OPENBMC_PATH/package/Config.in"
endif

comment "Custom Packages"
source "$BR2_EXTERNAL_OPENBMC_PATH/custom/Config.in"
```

## openbmc/configs/ast2500_defconfig
```kconfig
BR2_arm=y
BR2_arm1176jzf_s=y
BR2_CCACHE=y
BR2_SSP_ALL=y
BR2_TOOLCHAIN_BUILDROOT_VENDOR="broomstick"
BR2_TOOLCHAIN_BUILDROOT_MUSL=y
BR2_KERNEL_HEADERS_4_10=y
BR2_GCC_VERSION_6_X=y
BR2_TOOLCHAIN_BUILDROOT_CXX=y
BR2_GCC_ENABLE_LTO=y
BR2_TARGET_GENERIC_HOSTNAME="broomstick"
BR2_TARGET_GENERIC_ISSUE="Welcome to OpenBMC Broomstick"
BR2_SYSTEM_DHCP="eth0"
BR2_ENABLE_LOCALE_WHITELIST="C en_AU"
BR2_ROOTFS_OVERLAY="../openbmc/overlay"
BR2_ROOTFS_POST_IMAGE_SCRIPT="../openbmc/scripts/create-fitimage"
BR2_LINUX_KERNEL=y
BR2_LINUX_KERNEL_CUSTOM_TARBALL=y
BR2_LINUX_KERNEL_CUSTOM_TARBALL_LOCATION="https://github.com/openbmc/linux/tarball/dev-4.10/linux-dev-4.10.tar.gz"
BR2_LINUX_KERNEL_DEFCONFIG="aspeed_g5"
BR2_LINUX_KERNEL_XZ=y
BR2_LINUX_KERNEL_DTS_SUPPORT=y
BR2_LINUX_KERNEL_INTREE_DTS_NAME="aspeed-bmc-opp-romulus"
BR2_PACKAGE_STRACE=y
BR2_PACKAGE_MTD=y
# BR2_PACKAGE_MTD_MTD_DEBUG is not set
# BR2_PACKAGE_MTD_NANDDUMP is not set
# BR2_PACKAGE_MTD_NANDTEST is not set
# BR2_PACKAGE_MTD_NANDWRITE is not set
# BR2_PACKAGE_MTD_UBIATTACH is not set
# BR2_PACKAGE_MTD_UBICRC32 is not set
# BR2_PACKAGE_MTD_UBIDETACH is not set
# BR2_PACKAGE_MTD_UBIFORMAT is not set
# BR2_PACKAGE_MTD_UBIMKVOL is not set
# BR2_PACKAGE_MTD_UBINFO is not set
# BR2_PACKAGE_MTD_UBINIZE is not set
# BR2_PACKAGE_MTD_UBIRENAME is not set
# BR2_PACKAGE_MTD_UBIRMVOL is not set
# BR2_PACKAGE_MTD_UBIRSVOL is not set
# BR2_PACKAGE_MTD_UBIUPDATEVOL is not set
# BR2_PACKAGE_MTD_UBIBLOCK is not set
BR2_PACKAGE_LM_SENSORS=y
BR2_PACKAGE_PDBG=y
BR2_PACKAGE_UBOOT_TOOLS=y
BR2_PACKAGE_MICROPYTHON=y
BR2_PACKAGE_MICROPYTHON_LIB=y
BR2_PACKAGE_AVAHI=y
BR2_PACKAGE_AVAHI_DAEMON=y
BR2_PACKAGE_DROPBEAR=y
BR2_PACKAGE_ETHTOOL=y
BR2_PACKAGE_IPERF=y
BR2_PACKAGE_MII_DIAG=y
BR2_PACKAGE_NUTTCP=y
BR2_PACKAGE_RSYNC=y
BR2_TARGET_ROOTFS_CPIO=y
BR2_TARGET_ROOTFS_CPIO_XZ=y
# BR2_TARGET_ROOTFS_TAR is not set
BR2_PACKAGE_HOST_UBOOT_TOOLS=y
BR2_PACKAGE_HOST_UBOOT_TOOLS_FIT_SUPPORT=y
BR2_PACKAGE_HOST_UBOOT_TOOLS_FIT_SIGNATURE_SUPPORT=y
BR2_OPENBMC_PLATFORM=y
BR2_PACKAGE_MEMBOOT=y
BR2_PACKAGE_OBMC_CONSOLE=y
BR2_PACKAGE_PFLASH=y
```

## openbmc/configs/openbmc.its
```
/dts-v1/;

/ {
        description = "broomstick";
        #address-cells = <1>;

        images {
                kernel@1 {
                        description = "Linux kernel";
                        data = /incbin/("KERNEL_BLOB");
                        type = "kernel";
                        arch = "arm";
                        os = "linux";
                        compression = "none";
                        load = <0x80001000>;
                        entry = <0x80001000>;
                        hash@1 {
                                algo = "sha1";
                        };
                };
                fdt@1 {
                        description = "machine dtb";
                        data = /incbin/("DTB_BLOB");
                        type = "flat_dt";
                        arch = "arm";
                        compression = "none";
                        hash@1 {
                                algo = "sha1";
                        };
                };
                ramdisk@1 {
                        description = "Broomstick filesystem";
                        data = /incbin/("ROOTFS_BLOB");
                        type = "ramdisk";
                        arch = "arm";
                        os = "linux";
                        compression = "lzma";
                        hash@1 {
                                algo = "sha1";
                        };
                };
	};

        configurations {
                default = "conf@1";
                conf@1 {
                        description = "Default configuration";
			kernel = "kernel@1";
			fdt = "fdt@1";
			ramdisk = "ramdisk@1";
                        hash@1 {
                                algo = "sha1";
                        };
                };
	};
};
```

## openbmc/configs/palmetto_defconfig
```kconfig
BR2_arm=y
BR2_CCACHE=y
BR2_TOOLCHAIN_BUILDROOT_VENDOR="broomstick"
BR2_BINUTILS_VERSION_2_31_X=y
BR2_GCC_VERSION_8_X=y
BR2_TARGET_GENERIC_HOSTNAME="broomstick"
BR2_TARGET_GENERIC_ISSUE="Welcome to OpenBMC Broomstick"
BR2_SYSTEM_DHCP="eth0"
BR2_ENABLE_LOCALE_WHITELIST="C en_AU"
BR2_ROOTFS_OVERLAY="../openbmc/overlay"
BR2_ROOTFS_POST_BUILD_SCRIPT="../openbmc/scripts/fix-fstab"
BR2_ROOTFS_POST_IMAGE_SCRIPT="../openbmc/scripts/create-fitimage"
BR2_LINUX_KERNEL=y
BR2_LINUX_KERNEL_CUSTOM_TARBALL=y
BR2_LINUX_KERNEL_CUSTOM_TARBALL_LOCATION="https://github.com/openbmc/linux/tarball/dev-4.19/linux-dev-4.19.tar.gz"
BR2_LINUX_KERNEL_DEFCONFIG="aspeed_g4"
BR2_LINUX_KERNEL_XZ=y
BR2_LINUX_KERNEL_DTS_SUPPORT=y
BR2_LINUX_KERNEL_INTREE_DTS_NAME="aspeed-bmc-opp-palmetto"
BR2_LINUX_KERNEL_NEEDS_HOST_OPENSSL=y
BR2_LINUX_KERNEL_NEEDS_HOST_LIBELF=y
BR2_PACKAGE_LINUX_TOOLS_GPIO=y
BR2_PACKAGE_LINUX_TOOLS_IIO=y
BR2_PACKAGE_BUSYBOX_SHOW_OTHERS=y
BR2_PACKAGE_STRACE=y
BR2_PACKAGE_MTD=y
# BR2_PACKAGE_MTD_MTD_DEBUG is not set
# BR2_PACKAGE_MTD_NANDDUMP is not set
# BR2_PACKAGE_MTD_NANDTEST is not set
# BR2_PACKAGE_MTD_NANDWRITE is not set
# BR2_PACKAGE_MTD_UBIATTACH is not set
# BR2_PACKAGE_MTD_UBICRC32 is not set
# BR2_PACKAGE_MTD_UBIDETACH is not set
# BR2_PACKAGE_MTD_UBIFORMAT is not set
# BR2_PACKAGE_MTD_UBIMKVOL is not set
# BR2_PACKAGE_MTD_UBINFO is not set
# BR2_PACKAGE_MTD_UBINIZE is not set
# BR2_PACKAGE_MTD_UBIRENAME is not set
# BR2_PACKAGE_MTD_UBIRMVOL is not set
# BR2_PACKAGE_MTD_UBIRSVOL is not set
# BR2_PACKAGE_MTD_UBIUPDATEVOL is not set
# BR2_PACKAGE_MTD_UBIBLOCK is not set
BR2_PACKAGE_I2C_TOOLS=y
BR2_PACKAGE_LM_SENSORS=y
BR2_PACKAGE_PDBG=y
BR2_PACKAGE_UBOOT_TOOLS=y
BR2_PACKAGE_AVAHI=y
BR2_PACKAGE_AVAHI_DAEMON=y
BR2_PACKAGE_DROPBEAR=y
BR2_PACKAGE_ETHTOOL=y
BR2_PACKAGE_MII_DIAG=y
BR2_PACKAGE_RSYNC=y
BR2_PACKAGE_TCPDUMP=y
BR2_PACKAGE_BASH=y
BR2_TARGET_ROOTFS_CPIO=y
BR2_TARGET_ROOTFS_CPIO_XZ=y
# BR2_TARGET_ROOTFS_TAR is not set
BR2_PACKAGE_HOST_UBOOT_TOOLS=y
BR2_PACKAGE_HOST_UBOOT_TOOLS_FIT_SUPPORT=y
BR2_PACKAGE_HOST_UBOOT_TOOLS_FIT_SIGNATURE_SUPPORT=y
BR2_OPENBMC_PLATFORM=y
BR2_PACKAGE_MEMBOOT=y
BR2_PACKAGE_OBMC_CONSOLE=y
BR2_PACKAGE_PFLASH=y
```

## openbmc/package/Config.in
```kconfig
source "$BR2_EXTERNAL_OPENBMC_PATH/package/memboot/Config.in"
source "$BR2_EXTERNAL_OPENBMC_PATH/package/obmc-console/Config.in"
source "$BR2_EXTERNAL_OPENBMC_PATH/package/pflash/Config.in"
```

## openbmc/package/obmc-console/Config.in
```kconfig
config BR2_PACKAGE_OBMC_CONSOLE
	bool "obmc-console"
	help
	 Daemon to handle UART console connections
```

## openbmc/package/pdbg/Config.in
```kconfig
config BR2_PACKAGE_PDBG
	bool "pdbg"
	depends on BR2_arm
	help
	  PowerPC FSI Debugger, for low level debugging of a PowerPC CPU
	  over FSI
```
